## conf/layer.conf
```bitbake
# We have a conf and classes directory, add to BBPATH
BBPATH .= ":${LAYERDIR}"

# We have recipes-* directories, add to BBFILES
BBFILES += "${LAYERDIR}/recipes-*/*/*.bb \
            ${LAYERDIR}/recipes-*/*/*.bbappend"

BBFILE_COLLECTIONS += "meta-pi-hole"
BBFILE_PATTERN_meta-pi-hole = "^${LAYERDIR}/"
BBFILE_PRIORITY_meta-pi-hole = "6"

LAYERDEPENDS_meta-pi-hole = "core networking-layer"
LAYERSERIES_COMPAT_meta-pi-hole = "walnascar"
```
